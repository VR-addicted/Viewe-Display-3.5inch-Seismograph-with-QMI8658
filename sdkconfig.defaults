## sdkconfig.defaults
```kconfig
# PSRAM Configuration
CONFIG_SPIRAM=y
CONFIG_SPIRAM_MODE_OCT=y
CONFIG_SPIRAM_SPEED_80M=y
CONFIG_SPIRAM_BOOT_INIT=y
CONFIG_SPIRAM_USE_MALLOC=y

# Flash Size and Mode
CONFIG_ESPTOOLPY_FLASHSIZE_16MB=y
CONFIG_ESPTOOLPY_FLASHMODE_QIO=y
CONFIG_ESPTOOLPY_FLASHFREQ_80M=y

# Common Settings
CONFIG_FREERTOS_HZ=1000
CONFIG_COMPILER_CXX_EXCEPTIONS=y
CONFIG_ESP_DEFAULT_CPU_FREQ_MHZ_240=y

# Bypass I2C Legacy Conflict Check (Allows mixing legacy i2c and new i2c_master drivers)
CONFIG_I2C_SKIP_LEGACY_CONFLICT_CHECK=y
```
